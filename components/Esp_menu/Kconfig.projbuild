## components/Esp_menu/Kconfig.projbuild
```kconfig
menu "Esp_Menu Configuration"
    
    config ESPMENU_ENABLE
        bool "Enable Esp_Menu"
        default y
        help
            Enable Esp_Menu component
    
    config ESPMENU_I2C_HOST
        int "I2C Host"
        default 0
        help
            I2C host to use for the SSD1306 display. Default is 0.
            If you have a different display, check the datasheet for the correct host.
   
    choice ESPMENU_SSD1306_HEIGHT
        prompt "SSD1306 Height in pixels"
        default ESPMENU_SSD1306_HEIGHT_64
        help
            Height of the display in pixels. a.k.a vertical resolution

        config ESPMENU_SSD1306_HEIGHT_64
            bool "64"
        config ESPMENU_SSD1306_HEIGHT_32
            bool "32"
    endchoice

    config ESPMENU_SSD1306_HEIGHT
        int
        default 64 if ESPMENU_SSD1306_HEIGHT_64
        default 32 if ESPMENU_SSD1306_HEIGHT_32

    config ESPMENU_SSD1306_I2C_ADDRESS
        hex "SSD1306 I2C Address"
        default 0x3C
        help
            I2C address of the SSD1306 display. Default is 0x3C.
            This is the default address for most SSD1306 displays.
            If you have a different display, check the datasheet for the correct address.
   
    config ESPMENU_SSD1306_I2C_SDA
        int "SSD1306 I2C SDA Pin"
        default 21
        help
            I2C SDA pin for the SSD1306 display. Default is GPIO 21.
            If you have a different display, check the datasheet for the correct pin.
            
    config ESPMENU_SSD1306_I2C_SCL
        int "SSD1306 I2C SCL Pin"
        default 22
        help
            I2C SCL pin for the SSD1306 display. Default is GPIO 22.
            If you have a different display, check the datasheet for the correct pin.

    choice ESPMENU_ROTARY_ENCODER_CNT
        prompt "Rotary Encoder Count"
        default ESPMENU_ROTARY_ENCODER_CNT_1
        help
            Number of rotary encoders to use. Default is 1.
            If you have a different number of encoders, select the appropriate option.

        config ESPMENU_ROTARY_ENCODER_CNT_1
            bool "1"
        config ESPMENU_ROTARY_ENCODER_CNT_2
            bool "2"
        config ESPMENU_ROTARY_ENCODER_CNT_3
            bool "3"
        config ESPMENU_ROTARY_ENCODER_CNT_4
            bool "4"
        
    endchoice
    
    if ESPMENU_ROTARY_ENCODER_CNT_1 || ESPMENU_ROTARY_ENCODER_CNT_2 || ESPMENU_ROTARY_ENCODER_CNT_3 || ESPMENU_ROTARY_ENCODER_CNT_4
        config ESPMENU_ROTARY_ENCODER_1_A
            int "Rotary Encoder 1 A Pin"
            default 34
            help
                GPIO pin for the first rotary encoder A channel. Default is GPIO 34.
                If you have a different display, check the datasheet for the correct pin.
                
        config ESPMENU_ROTARY_ENCODER_1_B
            int "Rotary Encoder 1 B Pin"
            default 35
            help
                GPIO pin for the first rotary encoder B channel. Default is GPIO 35.
                If you have a different display, check the datasheet for the correct pin.

        config ESPMENU_ROTARY_ENCODER_1_BUTTON
            int "Rotary Encoder 1 Button Pin"
            default 0
            help
                GPIO pin for the first rotary encoder button. Default is GPIO 0.
                If you have a different display, check the datasheet for the correct pin.
    endif
    if ESPMENU_ROTARY_ENCODER_CNT_2 || ESPMENU_ROTARY_ENCODER_CNT_3 || ESPMENU_ROTARY_ENCODER_CNT_4
        config ESPMENU_ROTARY_ENCODER_2_A
            int "Rotary Encoder 2 A Pin"
            default 32
            help
                GPIO pin for the second rotary encoder A channel. Default is GPIO 32.
                If you have a different display, check the datasheet for the correct pin.
                
        config ESPMENU_ROTARY_ENCODER_2_B
            int "Rotary Encoder 2 B Pin"
            default 33
            help
                GPIO pin for the second rotary encoder B channel. Default is GPIO 33.
                If you have a different display, check the datasheet for the correct pin.

        config ESPMENU_ROTARY_ENCODER_2_BUTTON
            int "Rotary Encoder 2 Button Pin"
            default 0
            help
                GPIO pin for the second rotary encoder button. Default is GPIO 0.
                If you have a different display, check the datasheet for the correct pin.
    endif
    if ESPMENU_ROTARY_ENCODER_CNT_3 || ESPMENU_ROTARY_ENCODER_CNT_4
        config ESPMENU_ROTARY_ENCODER_3_A
            int "Rotary Encoder 3 A Pin"
            default 32
            help
                GPIO pin for the third rotary encoder A channel. Default is GPIO 32.
                If you have a different display, check the datasheet for the correct pin.
                
        config ESPMENU_ROTARY_ENCODER_3_B
            int "Rotary Encoder 3 B Pin"
            default 33
            help
                GPIO pin for the third rotary encoder B channel. Default is GPIO 33.
                If you have a different display, check the datasheet for the correct pin.

        config ESPMENU_ROTARY_ENCODER_3_BUTTON
            int "Rotary Encoder 3 Button Pin"
            default 0
            help
                GPIO pin for the third rotary encoder button. Default is GPIO 0.
                If you have a different display, check the datasheet for the correct pin.
    endif
    if ESPMENU_ROTARY_ENCODER_CNT_4
        config ESPMENU_ROTARY_ENCODER_4_A
            int "Rotary Encoder 4 A Pin"
            default 32
            help
                GPIO pin for the fourth rotary encoder A channel. Default is GPIO 32.
                If you have a different display, check the datasheet for the correct pin.
                
        config ESPMENU_ROTARY_ENCODER_4_B
            int "Rotary Encoder 4 B Pin"
            default 33
            help
                GPIO pin for the fourth rotary encoder B channel. Default is GPIO 33.
                If you have a different display, check the datasheet for the correct pin.

        config ESPMENU_ROTARY_ENCODER_4_BUTTON
            int "Rotary Encoder 4 Button Pin"
            default 0
            help
                GPIO pin for the fourth rotary encoder button. Default is GPIO 0.
                If you have a different display, check the datasheet for the correct pin.
    endif
        
endmenu
```

## components/esp_menu/Kconfig.projbuild
```kconfig
menu "ESP Menu Configuration"

    config ESP_MENU_JSON_PATH
        string "Path to menu JSON file"
        default "assets/menu.json"
        help
            Path to the JSON file defining the menu structure, relative to the component directory.

    config ESPMENU_ENABLE
        bool "Enable ESP Menu"
        default y
        help
            Enable ESP Menu component

    config ESPMENU_ENABLE_NVS
        bool "Enable NVS support for ESP Menu"
        default y
        help
            Enable NVS for saving menu parameters and favorite slots.

    config ESPMENU_AUTO_SAVE
        bool "Auto-save parameters on change"
        default n
        depends on ESPMENU_ENABLE_NVS
        help
            Automatically save parameters to NVS when they are changed.
            If disabled, parameters are only saved when manually triggered via menu.

    config ESPMENU_AUTO_SAVE_DELAY_MS
        int "Auto-save delay in milliseconds"
        default 1000
        range 100 10000
        depends on ESPMENU_AUTO_SAVE
        help
            Delay before auto-saving to NVS after parameter change.
            This prevents excessive NVS writes when rapidly changing values.

    config ESPMENU_I2C_HOST
        int "I2C Host"
        default 0
        help
            I2C host to use for the OLED display. Default is 0.
            If you have a different display, check the datasheet for the correct host.

    choice ESPMENU_DISPLAY_TYPE
        prompt "OLED Display Type"
        default ESPMENU_DISPLAY_SSD1306
        help
            Select the type of OLED display controller used.

        config ESPMENU_DISPLAY_SSD1306
            bool "SSD1306"
            help
                Use SSD1306 OLED display controller.

        config ESPMENU_DISPLAY_SH1107
            bool "SH1107"
            help
                Use SH1107 OLED display controller (compatibility mode).
    endchoice

    choice ESPMENU_DISPLAY_HEIGHT
        prompt "Display Height in pixels"
        default ESPMENU_DISPLAY_HEIGHT_64
        help
            Height of the display in pixels. a.k.a vertical resolution

        config ESPMENU_DISPLAY_HEIGHT_64
            bool "64"
        config ESPMENU_DISPLAY_HEIGHT_32
            bool "32"
    endchoice

    config ESPMENU_DISPLAY_HEIGHT
        int
        default 64 if ESPMENU_DISPLAY_HEIGHT_64
        default 32 if ESPMENU_DISPLAY_HEIGHT_32

    config ESPMENU_DISPLAY_I2C_ADDRESS
        hex "Display I2C Address"
        default 0x3C if ESPMENU_DISPLAY_SSD1306
        default 0x3C if ESPMENU_DISPLAY_SH1107
        help
            I2C address of the OLED display. Default is 0x3C for both SSD1306 and SH1107.
            This is the default address for most OLED displays.
            If you have a different display, check the datasheet for the correct address.

    config ESPMENU_DISPLAY_I2C_SDA
        int "Display I2C SDA Pin"
        default 8
        help
            I2C SDA pin for the OLED display. Default is GPIO 21.
            If you have a different display, check the datasheet for the correct pin.

    config ESPMENU_DISPLAY_I2C_SCL
        int "Display I2C SCL Pin"
        default 9
        help
            I2C SCL pin for the OLED display. Default is GPIO 22.
            If you have a different display, check the datasheet for the correct pin.

    choice ESPMENU_ROTARY_ENCODER_CNT
        prompt "Rotary Encoder Count"
        default ESPMENU_ROTARY_ENCODER_CNT_1
        help
            Number of rotary encoders to use. Default is 1.
            If you have a different number of encoders, select the appropriate option.

        config ESPMENU_ROTARY_ENCODER_CNT_1
            bool "1"
        config ESPMENU_ROTARY_ENCODER_CNT_2
            bool "2"
        config ESPMENU_ROTARY_ENCODER_CNT_3
            bool "3"
        config ESPMENU_ROTARY_ENCODER_CNT_4
            bool "4"

    endchoice

if ESPMENU_ROTARY_ENCODER_CNT_1 || ESPMENU_ROTARY_ENCODER_CNT_2 || ESPMENU_ROTARY_ENCODER_CNT_3 || ESPMENU_ROTARY_ENCODER_CNT_4
    config ESPMENU_ROTARY_ENCODER_1_A
        int "Rotary Encoder 1 A Pin"
        default 12
        help
            GPIO pin for the first rotary encoder A channel. Default is GPIO 34.
            If you have a different encoder, check the datasheet for the correct pin.

    config ESPMENU_ROTARY_ENCODER_1_B
        int "Rotary Encoder 1 B Pin"
        default 13
        help
            GPIO pin for the first rotary encoder B channel. Default is GPIO 35.
            If you have a different encoder, check the datasheet for the correct pin.

    config ESPMENU_ROTARY_ENCODER_1_BUTTON
        int "Rotary Encoder 1 Button Pin"
        default 14
        help
            GPIO pin for the first rotary encoder button. Default is GPIO 0.
            If you have a different encoder, check the datasheet for the correct pin.
endif
if ESPMENU_ROTARY_ENCODER_CNT_2 || ESPMENU_ROTARY_ENCODER_CNT_3 || ESPMENU_ROTARY_ENCODER_CNT_4
    config ESPMENU_ROTARY_ENCODER_2_A
        int "Rotary Encoder 2 A Pin"
        default 15
        help
            GPIO pin for the second rotary encoder A channel. Default is GPIO 32.
            If you have a different encoder, check the datasheet for the correct pin.

    config ESPMENU_ROTARY_ENCODER_2_B
        int "Rotary Encoder 2 B Pin"
        default 16
        help
            GPIO pin for the second rotary encoder B channel. Default is GPIO 33.
            If you have a different encoder, check the datasheet for the correct pin.

    config ESPMENU_ROTARY_ENCODER_2_BUTTON
        int "Rotary Encoder 2 Button Pin"
        default 17
        help
            GPIO pin for the second rotary encoder button. Default is GPIO 0.
            If you have a different encoder, check the datasheet for the correct pin.
endif
if ESPMENU_ROTARY_ENCODER_CNT_3 || ESPMENU_ROTARY_ENCODER_CNT_4
    config ESPMENU_ROTARY_ENCODER_3_A
        int "Rotary Encoder 3 A Pin"
        default 18
        help
            GPIO pin for the third rotary encoder A channel. Default is GPIO 32.
            If you have a different encoder, check the datasheet for the correct pin.

    config ESPMENU_ROTARY_ENCODER_3_B
        int "Rotary Encoder 3 B Pin"
        default 22
        help
            GPIO pin for the third rotary encoder B channel. Default is GPIO 33.
            If you have a different encoder, check the datasheet for the correct pin.

    config ESPMENU_ROTARY_ENCODER_3_BUTTON
        int "Rotary Encoder 3 Button Pin"
        default 22
        help
            GPIO pin for the third rotary encoder button. Default is GPIO 0.
            If you have a different encoder, check the datasheet for the correct pin.
endif
if ESPMENU_ROTARY_ENCODER_CNT_4
    config ESPMENU_ROTARY_ENCODER_4_A
        int "Rotary Encoder 4 A Pin"
        default 23
        help
            GPIO pin for the fourth rotary encoder A channel. Default is GPIO 32.
            If you have a different encoder, check the datasheet for the correct pin.

    config ESPMENU_ROTARY_ENCODER_4_B
        int "Rotary Encoder 4 B Pin"
        default 24
        help
            GPIO pin for the fourth rotary encoder B channel. Default is GPIO 33.
            If you have a different encoder, check the datasheet for the correct pin.

    config ESPMENU_ROTARY_ENCODER_4_BUTTON
        int "Rotary Encoder 4 Button Pin"
        default 25
        help
            GPIO pin for the fourth rotary encoder button. Default is GPIO 0.
            If you have a different encoder, check the datasheet for the correct pin.
endif

    choice ESPMENU_DISPLAY_WIDTH
        prompt "Display Width in pixels"
        default ESPMENU_DISPLAY_WIDTH_128
        help
            Width of the display in pixels. a.k.a horizontal resolution

        config ESPMENU_DISPLAY_WIDTH_128
            bool "128"
        config ESPMENU_DISPLAY_WIDTH_64
            bool "64"
    endchoice

    config ESPMENU_DISPLAY_WIDTH
        int
        default 128 if ESPMENU_DISPLAY_WIDTH_128
        default 64 if ESPMENU_DISPLAY_WIDTH_64

endmenu
```
